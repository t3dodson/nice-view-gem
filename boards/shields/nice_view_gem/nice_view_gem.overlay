/*
 * Copyright (c) 2022 The ZMK Contributors
 *
 * SPDX-License-Identifier: MIT
 */

&pro_micro_spi {
    status = "okay";
    cs-gpios = <&pro_micro 1 GPIO_ACTIVE_HIGH>;

    nice_view: ls0xx@0 {
        compatible = "sharp,ls0xx";
        spi-max-frequency = <1000000>;
        reg = <0>;
        width = <160>;
        height = <68>;
        serial-vcom-inversion;
        serial-vcom-interval = <33>;
    };
};

/ {
    chosen {
        zephyr,display = &nice_view;
    };
};
